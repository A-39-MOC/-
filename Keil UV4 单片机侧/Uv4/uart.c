#include <reg52.h>
#include "uart.h"
	
/*******************************************************************************
* 函 数 名        : uart_init
* 函数功能		  : 串口初始化
* 输    入        : void
* 输    出        : void
*******************************************************************************/
void uart_init(void)
{
	TMOD &= 0x0F;
	TMOD |= 0x20;	//定时器模式8位自动重装
	SCON &= 0x0F;
	SCON |= 0x40;	//8位数据位，无校验，禁止串行接收
	TH1 = 0xFD;
	TL1 = 0xFD;		//波特率9600
	PCON &= 0x7F;	//波特率不加倍，B7=0不加倍，=1加倍
	ES = 0;			//串口中断禁止，如果启用了串行接收，则需要使用查询方式检查是否收到数据
	TR1 = 1;		//启动T1
	EA = 1;			//全局中断使能
}

/*******************************************************************************
* 函 数 名        : uart_send_byte
* 函数功能		  : 发送一个字节
* 输    入        : char byte
* 输    出        : void
*******************************************************************************/
void uart_send_byte(uchar byte)
{
	SBUF = byte;
	while(!TI);		 //等待发送数据完成
	TI=0;			 //清除发送完成标志位，切勿在中断里面执行TI=0;语句，否则在主函数中发送数据将会卡死
}

/*******************************************************************************
* 函 数 名        : uart_send_bytes
* 函数功能		  : 发送字节数组
* 输    入        : uchar *bytes			发送的字节数组
					uchar length		数据长度
* 输    出        : void
*******************************************************************************/
void uart_send_bytes(uchar *bytes, uchar length)
{
	uchar idx;
	for(idx = 0; idx < length; idx++)
	{
		uart_send_byte(bytes[idx]);
	}
}

/*******************************************************************************
* 函 数 名        : uart_send_str
* 函数功能		  : 发送字符串
* 输    入        : uchar *str
* 输    出        : void
*******************************************************************************/
void uart_send_str(uchar *str)
{
	while(*str)
	{
		uart_send_byte(*str++);
	}
}

/*******************************************************************************
* 函 数 名        : uart_recv_check
* 函数功能		  : 串口接收检测
* 输    入        : void
* 输    出        : bit
*******************************************************************************/
//bit uart_recv_check(void)
//{
//	if(RI)			//如果接收标志置位
//	{
//		RI = 0;		//清除接收标志
//		uartData = SBUF;
//		return 1;
//	}
//	return 0;
//}
